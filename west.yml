## west.yml
```yaml
manifest:
  # lowest version of the manifest file schema that can parse this file’s data
  version: 0.8

  projects:
    - name: app_eric
      url: https://github.com/rmarco30/app_eric
      revision: master
      # import everything in app_eric's west.yml file except app_glen and app_x
      # this way, app_glen will always be in sync with the zephyr version (and its imports) used by app_eric
      import:
        name-blocklist:
          - app_glen
          - app_x

  # Settings applied using the self key will only be applied to the manifest repository
  self:
    path: app_glen
```
